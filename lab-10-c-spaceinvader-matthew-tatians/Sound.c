// Sound.c
// Runs on any computer
// Sound assets based off the original Space Invaders 
// Import these constants into your SpaceInvaders.c for sounds!
// Jonathan Valvano
// November 17, 2014
#include <stdint.h>
#include "Sound.h"
#include "DAC.h"
#include "ADC.h"
#include "Timer1.h"
#include "Timer0.h"
#include "../inc/tm4c123gh6pm.h"
#include "ST7735.h"


#define DF  4510   // 554.4 Hz
#define D   4257   // 587.3 Hz
#define EF  4018   // 622.3 Hz
#define E   3792   // 659.3 Hz
#define F   3579   // 698.5 Hz
#define GF  3378   // 740 Hz
#define G   3189   // 784 Hz
#define AF  3010   // 830.6 Hz
#define A   2841   // 880 Hz
#define BF  2681   // 932.3 Hz
#define B   2531   // 987.8 Hz
#define C   2389   // 1046.5 Hz

#define DFhi	DF/2
#define Dhi 	D/2
#define EFhi	EF/2
#define Ehi 	E/2
#define Fhi 	F/2
#define GFhi	GF/2
#define Ghi		G/2
#define AFhi	AF/2
#define Ahi		A/2
#define BFhi	BF/2
#define Bhi		B/2
#define Chi		C/2

#define DFlo	DF*3/2
#define Dlo		D*3/2
#define EFlo	EF*3/2
#define Elo		E*3/2
#define Flo		F*3/2
#define GFlo	GF*3/2
#define Glo		G*3/2
#define AFlo	AF*3/2
#define Alo		A*3/2
#define BFlo	BF*3/2
#define Blo		B*3/2
#define Clo		C*3/2

#define DFlolo	DFlo*3/2
#define Dlolo		Dlo*3/2
#define EFlolo	EFlo*3/2
#define	Elolo		Elo*3/2
#define Flolo		Flo*3/2
#define	GFlolo	GFlo*3/2
#define Glolo		Glo*3/2
#define Aflolo	Aflo*3/2
#define Alolo		Alo*3/2
#define	BFlolo	BFlo*3/2
#define Blolo		Blo*3/2
#define	Clolo		Clo*3/2




#define pause 0
#define null 0xFFFF

void Sound_Init(void);
void Sound_Play(const uint8_t *pt, uint32_t count);

void PlaySFX(void);
void Button_Press(void);
void Pikachu_Cry(void);
void Victory_SFX(void);
void Loss_SFX(void);
void end_SFX(void);

void PlayBGM(void);

void set_BGM_1(void);
void set_BGM_2(void);
void end_BGM(void);

void SysTick_Handler(void);
void SysTick_Init(void);
void Disable_BGM(void);
void Enable_BGM(void);

//6k sampling, 32-bit mono
unsigned char pikachuCry3[4966] = {31,32,32,32,32,31,32,31,32,31,32,31,32,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31,31};
//unsigned char buttonPress[1795] = {32,31,32,31,32,31,32,31,32,31,32,31,30,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30,33};

//piano
unsigned char sineArr2[32] = {32, 38, 44, 49, 54, 58, 61, 62, 63, 62, 61, 58, 54, 49, 44, 38, 32, 26, 20, 15, 10, 6, 3, 2, 1, 2, 3, 6, 10, 15, 20, 26};
uint32_t victorySequence[] = {E, GF, AF, A, B, B, B, B, B, B, pause, pause, pause, B, A, AF, A, B, pause, B, pause, B, pause, pause, DFhi, pause, DFhi, pause, DFhi, pause, pause, B, pause, B, pause, B, pause, null};
uint32_t lossSequence[] = {D, pause, pause, DF, pause, pause, Clo, pause, pause, Blo, Blo, Blo, Blo, null};
uint32_t battleTheme[] = {Dlo, pause, Dlo, pause, Alo, Alo, pause, Dlo, pause, Dlo, pause, BFlo, BFlo, pause, Dlo, pause, Dlo, pause,
	Alo, Alo, pause, Dlo, pause, Dlo, pause, GFlo, GFlo, pause, Dlo, pause, Dlo, pause, Alo, Alo, pause, Dlo, pause, Dlo, pause, DF, DF, pause,
	D, D, D, D, pause, Alolo, Alolo, Alolo, Alolo, pause, Clo, Clo, Clo, Clo, pause, Clolo, Clolo, Clolo, Clolo, pause, Dlo, Dlo, pause, pause, null};
uint32_t entranceTheme[] = {Alo, Alo, Alo, A, pause, Alo, D, pause, pause, pause, pause, pause, Ghi, pause, pause, GFhi, pause, pause, Dhi, Alo, pause, E, pause, pause, 
	Elo, Elo, Elo, A, pause, A, D, pause, pause, pause, pause, pause, E, pause, pause, D, pause, pause, Alo, GFlo, pause, Blo, pause, pause, Alo, D, pause, pause, D, E, E, 
	D, D, Alo, Alo, BFlo, BFlo, Blo, pause, pause, D, E, Alo, pause, Ghi, pause, pause, GFhi, pause, D, pause, pause, pause, Glo, GFlo, pause, 
	D, pause, B, A, pause, pause, G, pause, pause, G, pause, pause, E, D, E, GF, pause, pause, G, GF, pause, D, pause, Alo, D, pause, pause, Alo, 
	pause, pause, D, pause, pause, E, GF, G, A, A, D, D, Alo, Alo, A, A, D, D, A, A, D, D, Alo, Alo, D, pause, pause, pause, pause, pause, E, pause, E, 
	GF, E, D, DF, DF, DF, DF, DF, DF, E, E, Blo, Blo, Blo, Blo, Blo, Blo, D, D, DF, DF, DF, DF, DF, DF, GF, GF, DF, D, D, D,
	D, D, D, F, F, BF, null}; 

uint32_t test[] = {pause, pause, pause, pause, null};
uint32_t scaleSequence[] = {DFlo, Dlo, EFlo, Elo, Flo, GFlo, Glo, AFlo, Alo, BFlo, Blo, Clo, 
	DF, D, EF, E, F, GF, G, AF, A, BF, B, C, 
	DFhi, Dhi, EFhi, Ehi, Fhi, GFhi, Ghi, AFhi, Ahi, BFhi, Bhi, Chi, null};	//fix pause with GFlo
uint32_t buttonSequence[] = {Ahi, Ghi, Ahi, G, null};
	
uint32_t size_SFX, size_BGM;
unsigned char *sfx;
uint32_t *bgm;
const uint32_t period = 80000000/6000;
uint8_t mode, BGM_on;
	


void Sound_Init(void){
	Timer1_Init(&PlaySFX, period);
	Timer0_Init(&PlayBGM, period);
	
	SysTick_Init();
};

/* SFX */

/**
*PlaySFX is called by Timer1A_Handler
*plays sfx until disabled by end_SFX
*/
void PlaySFX(void){
	if(mode == 0){
		static uint32_t idx = 0;
		uint8_t modifier;
		//signed char mVal;
		modifier = getVolumeModifier();
		//mVal = (sfx[idx] - 32) * modifier;
		DAC_Out(sfx[idx++]* modifier);// + mVal);
		//turn off SFX if done playing
		if(idx >= size_SFX ) {
			end_SFX();
			idx = 0;
		}
		//test output of modifier, DAC_Out
		//ST7735_SetCursor(0, 11);
		//ST7735_OutUDec(modifier);	ST7735_OutString("    "); 
	}else{
		//play a note of x frequency until end_SFX is called
		static uint8_t idx2 = 0;
		uint8_t modifier;
		modifier = getVolumeModifier();
		DAC_Out(sineArr2[idx2] * modifier);
		idx2 = (idx2 + 1) % 32;
	}
}
/**
*Button_Press enable Timer1A
*plays Button_Press sfx until disabled by PlaySFX
*/
void Button_Press(void){
	mode = 1;	
	//TIMER1_TAILR_R = (80000000/6175)-1;
	//TIMER1_TAPR_R = 0;
	//TIMER1_CTL_R = 0x00000001; 
	//size_SFX = 1795;
	//sfx = buttonPress;
	
	//set frequency of interrupt based on note sequence
	for(uint8_t i = 0; buttonSequence[i] != null; i++){
		//play sound if sequence is not at 0
		if(buttonSequence[i] != pause){
			TIMER1_TAILR_R = buttonSequence[i]-1;
			TIMER1_TAPR_R = 0;
			TIMER1_CTL_R = 0x00000001; 
		}
		//delay for length of note then end
		for(uint32_t h = 0; h < 727240; h++); 
		end_SFX();
	}
};

/**
*Pikachu_Cry enable Timer1A
*plays Pikachu_Cry sfx until disabled by PlaySFX
*/
void Pikachu_Cry(void){
	//period = 80 000 000 / 6000
	mode = 0;	
	TIMER1_TAILR_R = (80000000/6000)-1;
	TIMER1_TAPR_R = 0;
	TIMER1_CTL_R = 0x00000001; 
	size_SFX = 4966;
	sfx = pikachuCry3;

};

/**
*Victory enable Timer1A
*plays Victory sfx until disabled by PlaySFX
*/
void Victory_SFX(void){
	mode = 1;
	
	//set frequency of interrupt based on note sequence
	for(uint8_t i = 0; victorySequence[i] != null; i++){
		//play sound if sequence is not at 0
		if(victorySequence[i] != pause){
			TIMER1_TAILR_R = victorySequence[i]-1;
			TIMER1_TAPR_R = 0;
			TIMER1_CTL_R = 0x00000001; 
		}
		//delay for length of note then end
		for(uint32_t h = 0; h < 727240; h++); 
		end_SFX();
	}
};

/**
*Loss enable Timer1A
*plays Loss sfx until disabled by PlaySFX
*/
void Loss_SFX(void){
	mode = 1;
	
	//set frequency of interrupt based on note sequence
	for(uint8_t i = 0; lossSequence[i] != null; i++){
		//play sound if sequence is not at 0
		if(lossSequence[i] != pause){
			TIMER1_TAILR_R = lossSequence[i]-1;
			TIMER1_TAPR_R = 0;
			TIMER1_CTL_R = 0x00000001; 
		}
		//delay for length of note then end
		for(uint32_t h = 0; h < 727240; h++); 
		end_SFX();
	}
};

/**
*end_SFX disables Timer1A
*/
void end_SFX(void){
	TIMER1_CTL_R = 0x00000000;
};


/* BGM */

/**
*PlayBGM is called by Timer0A_Handler
*plays bgm until disabled by end_BGM
*/
void PlayBGM(void){
	//play a note of x frequency until end_SFX is called - 
	static uint8_t idx3 = 0;
	uint8_t modifier;
	modifier = getVolumeModifier();
	DAC_Out(sineArr2[idx3] * modifier);
	idx3 = (idx3 + 1) % 32;
}	

/**
*set_BGM_1 sets bgm to battle theme
*/
void set_BGM_1(void){
	bgm = battleTheme;
}

/**
*set_BGM_2 sets bgm to title theme theme
*/
void set_BGM_2(void){
	bgm = entranceTheme;
}

/**
*end_BGM disables Timer0A
*/
void end_BGM(void){
	TIMER0_CTL_R = 0x00000000;
};

/**
*start_BGM enables Timer0A	//inactive
*/
void Start_BGM(void){
	TIMER0_CTL_R = 0x00000001;
}

/**
*Temporarily in charge of picking the notes and changing the frequency for PlayBGM
*/
void SysTick_Handler(void){
	//only play notes if BGM_on is active
	if(BGM_on == 1){
		static uint8_t BGM_idx = 0;
		//set frequency of interrupt based on note sequence
		//restart from beginning when null is reached
		if(bgm[BGM_idx] == null)
			BGM_idx = 0;
		//change sound frequency if next note to play isn't 0 or null
		if(bgm[BGM_idx] != pause){
			TIMER0_TAILR_R = bgm[BGM_idx]-1;
			TIMER0_TAPR_R = 0;
			TIMER0_CTL_R = 0x00000001; 
		}
		else
			end_BGM();
		BGM_idx ++;
	}
}

void SysTick_Init(void){
  NVIC_ST_CTRL_R = 0;                   // disable SysTick during setup
  NVIC_ST_RELOAD_R = 727240*10;						// reload value to 1ms bus clock
  NVIC_ST_CURRENT_R = 0;                // any write to current clears it
  NVIC_SYS_PRI3_R = (NVIC_SYS_PRI3_R&0x00FFFFFF)|0x40000000;                                      // enable SysTick with core clock
  NVIC_ST_CTRL_R = 0x07;//NVIC_ST_CTRL_ENABLE+NVIC_ST_CTRL_CLK_SRC;
	BGM_on = 1;
}

void Disable_BGM(void){
	BGM_on = 0;
}

void Enable_BGM(void){
	BGM_on = 1;
}

