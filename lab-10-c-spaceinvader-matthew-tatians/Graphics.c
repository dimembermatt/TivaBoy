// Graphics.c
// Runs on any computer
// graphics functions and image assets
// Matthew Yu and Tatian Flores
// 4/26/18
#include <stdint.h>
#include "../inc/tm4c123gh6pm.h"
#include "ST7735.h"										//display
#include "Sound.h"										//calling SFX
#include "Random.h"										//random animation generation
#include "Timer3.h"										//frame refresh
#include "Graphics.h"									//project global prototypes for sprites
//#include "SDCFile.h"									//sprite data access

void Graphics_Init(void);		//write this, connect to timer3A, write timer3A.c, .h
void Start_Refresh(void);
void Stop_Refresh(void);
void Clear_Buffer(uint16_t newColor);
void Set_Screen(uint8_t in);
void Refresh(void);
void Draw_Sprite(int32_t x, int32_t y, const unsigned short sprite[], uint16_t width, uint16_t height);
void unDraw_Sprite(int32_t x, int32_t y, uint16_t width, uint16_t height);

//general animations
void jump(uint16_t x, uint16_t y, const unsigned short sprite[], uint16_t width, uint16_t height, uint8_t speed);
void attackAnimation(const unsigned short sprite[], uint16_t width, uint16_t height, uint8_t side);


//specific animations
void pkmnTrainerRedAnimation(void);
void mainScreenAnimation(void);

uint8_t screen;
uint16_t color;



/** Start image assets **/
unsigned short Pikachu2[] = {
 0xFFFF, 0xFFFF, 0xFFFF, 0xFFFF, 0xFFFF, 0xFFFF, 0xFFFF, 0xFFFF, 0xFFFF, 0x2B2D, 0x00A4, 0x6B6D, 0xE6FB, 0xFFFF, 0xFFFF, 0xFFFF,
 0xFFFF, 0xFFDF, 0xD69A, 0xDEBA, 0xE73C, 0xFFFF, 0xFFFF, 0xFFFF, 0xFFFF, 0xFFFF, 0xFFFF, 0xFFFF, 0xFFFF, 0xFFFF, 0xFFFF, 0xFFFF,
 0x463A, 0x477F, 0x0B92, 0x0000, 0xFFFF, 0xFFFF, 0xFFFF, 0xFFFF, 0x424A, 0x01EC, 0x018B, 0x2124, 0xFFFF, 0xFFFF, 0xFFFF, 0xFFFF,
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 0xFFFF,
};

unsigned short Charizard2[] = {
 0xFFFF, 0xFFFF, 0xFFFF, 0xFFFF, 0xFFFF, 0xFFFF, 0xD699, 0xD678, 0xA513, 0xF7BE, 0xFFFF, 0xFFFF, 0xFFFF, 0xFFFF, 0xFFFF, 0xFFFF,
 0xFFFF, 0xFFFF, 0xFFFF, 0xFFFF, 0xFFFF, 0xFFFF, 0xFFFF, 0xFFFF, 0xFFFF, 0xFFFF, 0xFFFF, 0xFFFF, 0x7C75, 0x3AF2, 0x4336, 0x5C3A,
 0x320D, 0xFFDE, 0xFFFF, 0xFFFF, 0xEF5C, 0xB5B7, 0xBE3B, 0xA556, 0xB595, 0xF79E, 0xFFFF, 0xFFFF, 0xFFFF, 0xFFFF, 0xFFFF, 0xFFFF,
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 0xFFFF,
};

unsigned short Venusaur2[] = {
 0xFFFF, 0xFFFF, 0xEF9D, 0xEF5E, 0xE75B, 0xC638, 0xEF3E, 0xF7BE, 0xFFFF, 0xF7BE, 0xF77D, 0xF77D, 0xF77E, 0xF7BE, 0xFFFF, 0xFFFF,
 0xFFFF, 0xFFDF, 0xEF5D, 0xF79E, 0xEF3D, 0xEF5E, 0xFFFF, 0xFFFF, 0xFFFF, 0xBE74, 0x73CD, 0x956E, 0x6C2B, 0x744B, 0xAD76, 0xE7B9,
 0x8D8E, 0x6BCE, 0x73EF, 0x6C09, 0x7508, 0x9D51, 0xDE9C, 0xFFFF, 0xEF9C, 0x8CB0, 0x5389, 0x73AF, 0x4AE5, 0xD719, 0xFFFF, 0xFFFF,
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 0xFFFF,
};

const unsigned short Red2[] = {
 0xFFFF, 0xD6BB, 0xC618, 0xCE39, 0xC638, 0xCE58, 0xFFFF, 0xFFDF, 0xFFFF, 0xFFFF, 0xFFFF, 0xFFFF, 0xEF7D, 0xC639, 0xC638, 0xC618,
 0xCE79, 0xFFFF, 0xFFFF, 0xFFFF, 0xFFFF, 0xFFFF, 0xFFFF, 0xFFFF, 0xFFFF, 0xBDD7, 0x41C3, 0x6B6C, 0x738E, 0x20E1, 0x0007, 0x4A68,
 0x94D4, 0xFFFF, 0xFFFF, 0xFFFF, 0xE75D, 0x7B8A, 0x62C7, 0x632B, 0x632B, 0x4A68, 0xBDF7, 0xFFFF, 0xFFFF, 0xFFFF, 0xFFFF, 0xFFFF,
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 0xFFFF, 0xFFFF, 0xFFFF, 0xFFFF, 0xFFFF,
};

const unsigned short pokeball2[] = {
 0xFFFF, 0xFFFF, 0xFFFF, 0xFFFF, 0xFFFF, 0xFFFF, 0xFFFF, 0xFFFF, 0x6B4E, 0x1929, 0x3A4B, 0x0020, 0x630B, 0xFFFF, 0xF79E, 0x0000,
 0xB67F, 0xDFFF, 0xB65C, 0x0000, 0xF7BE, 0xF7BF, 0x52AB, 0xCE7F, 0x319D, 0x4A5F, 0x0002, 0xF7BE, 0xFFDE, 0x18C4, 0x39BD, 0x39FF,
 0x293B, 0x0864, 0xFFDE, 0xFFFF, 0xAD75, 0x212A, 0x000B, 0x296B, 0xC617, 0xFFFF, 0xFFFF, 0xFFFF, 0xFFFF, 0xFFFF, 0xFFFF, 0xFFFF,
 0xFFFF,
};

unsigned short fireSprite2[] = {
 0xFFFF, 0xFFFF, 0xFFFF, 0xFFFF, 0xFFFF, 0xFFFF, 0xFFFF, 0xFFFF, 0xFFFF, 0xFFFF, 0xFFFF, 0xF7FF, 0xAF3F, 0x365E, 0x871E, 0xCF9F,
 0x871E, 0x4E7E, 0xFFFF, 0xFFFF, 0xFFFF, 0x3E1E, 0x361E, 0xFFFF, 0xF7DF, 0x9F1E, 0x9F1E, 0x3E3E, 0x1D7E, 0xFFFF, 0xFFFF, 0x45FE,
 0xAF3F, 0xC77F, 0x8EFE, 0x565E, 0x25DE, 0x3E1E, 0x0CFE, 0xFFFF, 0xFFFF, 0x357E, 0x6E7E, 0x665E, 0xA71F, 0x2DBE, 0x359E, 0x355E,
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 0xFFFF, 0xFFFF, 0xFFFF, 0xFFFF,
};

unsigned short focus_blast[] = {
 0xFFFF, 0xFFFF, 0xFFFF, 0xFFFF, 0xEF9E, 0xA5BA, 0x7CF8, 0x7CF8, 0x7CB8, 0xB65B, 0xDF3E, 0xFFFF, 0xFFFF, 0xFFFF, 0xFFFF, 0xFFFF,
 0xFFFF, 0xFFFF, 0xA5DA, 0x6C77, 0x63B7, 0x6378, 0x6379, 0x6378, 0x42F7, 0x5BD7, 0x9D9A, 0xFFFF, 0xFFFF, 0xFFFF, 0xFFFF, 0xEF9E,
 0x8558, 0x63F8, 0x63BB, 0x6BFE, 0x7C7F, 0x7C7F, 0x7C7F, 0x63BE, 0x531B, 0x63D7, 0x9599, 0xF79F, 0xFFFF, 0xFFFF, 0x7DDA, 0x6C5A,
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 0xFFFF,
};

unsigned short dragon_claw[] = {
 0xFFFF, 0xFFFF, 0xFFFF, 0xFFFF, 0xFFFF, 0xFFFF, 0xD69A, 0xFFFF, 0xB5D6, 0xFFFF, 0xFFFF, 0xFFFF, 0xFFFF, 0xFFFF, 0xFFFF, 0xFFFF,
 0xFFFF, 0xFFFF, 0xFFFF, 0xFFFF, 0x9CF3, 0x9D14, 0xFFFF, 0x41E7, 0xF7BE, 0xFFFF, 0xFFFF, 0xFFFF, 0xFFFF, 0xFFFF, 0xFFFF, 0xFFFF,
 0xFFFF, 0xFFFF, 0xEF7D, 0x2104, 0xFFFF, 0xFFFF, 0xA555, 0x39C7, 0xFFFF, 0xFFFF, 0xFFFF, 0xFFFF, 0xFFFF, 0xFFFF, 0xFFFF, 0xFFFF,
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 0xFFDF, 0xFFFF,
};

unsigned short air_slash[] = {
 0xFFFF, 0xFFFF, 0xFFFF, 0xFFFF, 0xFFFF, 0xFFFF, 0xFFFF, 0xFFFF, 0xFFFF, 0xFFFF, 0xFFFF, 0xFFFF, 0xFFFF, 0xFFFF, 0xFFFF, 0xFFFF,
 0xFFFF, 0xFFFF, 0xFFFF, 0xFFFF, 0xFFFF, 0xB5F6, 0xFFFF, 0xFFFF, 0xFFFF, 0xFFFF, 0xFFFF, 0xFFFF, 0xFFFF, 0xFFFF, 0xFFFF, 0xBE57,
 0xDF1C, 0xFFFF, 0xFFFF, 0xFFFF, 0xFFFF, 0xFFFF, 0xFFFF, 0xFFFF, 0xFFFF, 0xD6DB, 0xB5F5, 0xFFFF, 0xFFFF, 0xFFFF, 0xFFFF, 0xFFFF,
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 0xFFFF, 0xFFFF, 0xFFFF, 0xFFFF,
};

unsigned short power_whip[] = {
 0xFFFF, 0xFFFF, 0xFFFF, 0xFFFF, 0xFFFF, 0xFFFF, 0xFFFF, 0xFFFF, 0xFFFF, 0xFFFF, 0xA594, 0xFFFF, 0xFFFF, 0xFFFF, 0xFFFF, 0xFFFF,
 0x4A89, 0x0180, 0x8531, 0xFFFF, 0xFFFF, 0xFFFF, 0xFFFF, 0x5D0C, 0xEF9D, 0xFFFF, 0xFFFF, 0xFFFF, 0xFFFF, 0xFFFF, 0x3A27, 0x02E0,
 0x04A2, 0xFFBE, 0xFFFF, 0xFFFF, 0x6CAE, 0x7E71, 0xFFFF, 0xFFFF, 0xFFFF, 0xFFFF, 0xFFFF, 0xFFFF, 0x636C, 0x0440, 0x0E25, 0xF79C,
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 0xFFFF, 0xFFFF, 0xFFFF, 0xFFFF, 0xFFFF, 0xFFFF, 0xFFFF, 0xFFFF, 0xFFFF, 0xFFFF,
};

unsigned short sludge_bomb[] = {
 0xFFFF, 0xFFFF, 0xFFFF, 0xFFFF, 0xFFFF, 0xFFFF, 0x700E, 0xB356, 0xFFFF, 0xFFFF, 0xFFFF, 0xFFFF, 0xFFFF, 0xFFFF, 0xFFFF, 0xA2F4,
 0xFFFF, 0xFFFF, 0xAA35, 0x780F, 0x88F1, 0xFFFF, 0xA274, 0xAB35, 0xFFFF, 0xFFFF, 0xFFFF, 0xCD19, 0x8010, 0x8010, 0xA335, 0x9152,
 0x8010, 0x90F2, 0xA335, 0x8010, 0xA1F4, 0xFFFF, 0xFFFF, 0xFFFF, 0xDE3B, 0x8951, 0x8010, 0x8811, 0x8811, 0x8010, 0x8811, 0x8811,
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 0xFFFF, 0xFFFF, 0xFFFF, 0xFFFF, 0xFFFF, 0xFFFF, 0xFFFF, 0xFFFF, 0xFFFF, 0xFFFF, 0xFFFF, 0xFFFF, 0xFFFF, 0xFFFF, 0xFFFF, 0xFFFF,
};

unsigned short skull_bash[] = {
 0xFFFF, 0xFFFF, 0xFFDD, 0xC659, 0xAD96, 0xB5B7, 0xBE19, 0x4AEF, 0x198C, 0x8452, 0xB5D5, 0xB5B6, 0x94F6, 0xB61D, 0xFFFF, 0xFFFF,
 0xF7BD, 0x08F1, 0x0951, 0x08CC, 0x00C8, 0x00EC, 0x00CE, 0x1A30, 0x2255, 0x11B1, 0x00CB, 0x0085, 0x0065, 0x112D, 0x6BD3, 0xDEFB,
 0x4250, 0x2E1F, 0x379F, 0x2B3C, 0x112B, 0x196E, 0x21CD, 0x343A, 0x355E, 0x351E, 0x22FB, 0x19B0, 0x7415, 0x00F0, 0x000A, 0xAD97,
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 0xFFFF, 0xFFFF, 0xFFFF, 0xFFFF, 0xFFFF, 0xFFFF, 0xFFFF, 0xFFFF, 0xFFFF, 0xFFDD, 0x8C32, 0x296B, 0xA534, 0xFFFF, 0xFFFF, 0xFFFF,
};

unsigned short earthquake[] = {
 0xFFFF, 0xFFFF, 0xFFFF, 0xFFFF, 0x2A91, 0xCEBD, 0xFFFF, 0xFFFF, 0xFFFF, 0xFFFF, 0xFFFF, 0xFFFF, 0xFFFF, 0x957A, 0x0002, 0x2A91,
 0xF7BF, 0xFFFF, 0xFFFF, 0xFFFF, 0xFFFF, 0xFFFF, 0xFFFF, 0x9DBB, 0x0001, 0x114A, 0x6C98, 0xFFFF, 0xFFFF, 0xFFFF, 0xFFFF, 0xFFFF,
 0xFFFF, 0x9DBA, 0x0063, 0x10E6, 0x2292, 0xDF3E, 0xFFFF, 0xFFFF, 0xFFFF, 0xFFFF, 0xFFFF, 0x9DBB, 0x116A, 0x10C6, 0x10E7, 0x2A91,
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 0x29AD, 0x29EE, 0x2AB2, 0xFFFF,
};

unsigned short volt_tackle[] = {
 0x4C70, 0x136C, 0x136C, 0x1B2B, 0x01E6, 0x63EE, 0x9D13, 0x9D13, 0xF79D, 0xFFFF, 0xFFFF, 0xFFFF, 0xFFFF, 0xFFFF, 0xFFFF, 0xFFFF,
 0xFFFF, 0xFFFF, 0xFFFF, 0xFFFF, 0xFFFF, 0xFFFF, 0xFFFF, 0x8DD7, 0x969A, 0x969A, 0x65F6, 0x7D75, 0x6C91, 0x8491, 0x8491, 0x6BAD,
 0xFFFF, 0xFFFF, 0xFFFF, 0xFFFF, 0xFFFF, 0xFFFF, 0xFFFF, 0xFFFF, 0xFFFF, 0xFFFF, 0xFFFF, 0xFFFF, 0xFFFF, 0xFFFF, 0x234C, 0x3C71,
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 0x5BEE, 0x3B2B, 0x536C, 0x6BEE, 0x6BEE, 0x9492,
};

unsigned short brick_break[] = {
 0xFFFF, 0xFFFF, 0xFFFF, 0xBF17, 0x4C49, 0x3B68, 0x4388, 0x4388, 0x4388, 0x4388, 0x4388, 0x4368, 0x3B67, 0x8651, 0xFFFF, 0xFFFF,
 0xE7BC, 0x23A5, 0x34E8, 0x32A6, 0x3206, 0x3226, 0x3A26, 0x3A26, 0x3226, 0x3A47, 0x3A47, 0x3A47, 0x3226, 0x44AA, 0xFFFF, 0xFFFF,
 0x5D2D, 0x31C6, 0x3206, 0x3A26, 0x3A47, 0x3A47, 0x3A47, 0x3A47, 0x3A47, 0x3AA7, 0x4348, 0x4348, 0x4348, 0x3B08, 0x1AA5, 0xB758,
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 0xFFFF, 0xFFFF, 0xFFFF, 0xF7FE, 0x95D1, 0x4B67, 0x53A8, 0x42C6, 0x5C29, 0xFFFF, 0xFFFF, 0xFFFF, 0xFFFF, 0xFFFF, 0xFFFF, 0xFFFF,
};




/**
*Top/Bottom Screen Buffer - Playing Field
*/
unsigned short PlayingFieldBuffer[120*60];

/** End image assets **/

/**
*Grab_Image takes a name (Pokemon, Move, Trainer),
*compares it with a list of objects, and finds object with that identifier.
*it then associates a prototype sprite with that name to the object.
*param - name identifier of object
*/
//void Grab_Image(char *name){
	//search file name, get width, height, size
	//grab contents from file
	//search prototype for identifier, generate array size
//}
	
/**
*Graphics_Init sets up Timer3 interrupt
*/
void Graphics_Init(void){
	Timer3_Init(&Refresh, 3333333);	//refresh rate of 26fps
}

/**
*Turns on and off buffer refresh interrupt
*/
void Start_Refresh(void){
	TIMER3_TAILR_R = 3333333;
	TIMER3_TAPR_R = 0;
	TIMER3_CTL_R = 0x00000001;
}
void Stop_Refresh(void){
	TIMER3_CTL_R = 0x00000000;
}

 /***********************************************************
 *graphic animation functions
 ************************************************************/
/**
*Clear Screen function blanks out the Playing Field in a color.
*init function.
*/
void Clear_Buffer(uint16_t newColor){
	color = newColor;
	for(uint32_t i = 0; i < 60*120; i++){
		PlayingFieldBuffer[i] = color;
	}
}

/**
*Set_Screen is a set method to set the Refresh function that's called on interrupt.
*/
void Set_Screen(uint8_t in){
	screen = in;
}

/**
*Refresh function redraws the screen.
*param - screen top or bottom screen (0 - bottom screen, 1 - top)
*/
void Refresh(){
	if(screen == 1)
		ST7735_DrawBitmap(5, 70, PlayingFieldBuffer, 120, 60);
	else
		ST7735_DrawBitmap(5, 160, PlayingFieldBuffer, 120, 60);
	GPIO_PORTF_DATA_R ^= 0x02;
}
/**
*Draw Sprite function takes a sprite and draws it onto the Playing Field.
*param - x of top left coord (assume all sprites are in boxes)
*param - y of top left coord
*param - sprite reference
*param - width of sprite
*param - height of sprite
*error handling to prefev
*/
void Draw_Sprite(int32_t x, int32_t y, const unsigned short sprite[], uint16_t width, uint16_t height){
	uint32_t index = 0, bufferIdx;
	for(int32_t row = y; row < (y + height); row++){
		for(int32_t column = x; column < (x + width); column ++){
			bufferIdx = row * 120 + column;
			//write pixel to screen if within bounds
			if(row >= 0 && row < 120 && column >= 0 && column < 120)
				PlayingFieldBuffer[bufferIdx] = sprite[index];
			index ++;
		}
	}
}

/**
*unDraw Sprite function takes a sprite box and redraws the bg
*param - x of top left coord (assume all sprites are in boxes)
*param - y of top left coord
*param - width of sprite
*param - height of sprite
*take note of what sprite is being undrawn
*/
void unDraw_Sprite(int32_t x, int32_t y, uint16_t width, uint16_t height){
	uint32_t index = 0, bufferIdx;
	for(int32_t row = y; row < (y + height); row++){
		for(int32_t column = x; column < (x + width); column ++){
			bufferIdx = row * 120 + column;
			//redraw bg
			//write pixel to screen if within bounds
			if(row >= 0 && row < 120 && column >= 0 && column < 120)
				PlayingFieldBuffer[bufferIdx] = color;
			index ++;
		}
	}
}


/**
* function jump moves sprite up 15 pixels and down.
* param: x - lower left pixel x coord of image
* param: y - lower left pixel y coord of image
* param: *sprite - reference to image sprite
* param: width - width of sprite
* param: height - height of sprite
* param: speed - speed of jump
*/
void jump(uint16_t x, uint16_t y, const unsigned short sprite[], uint16_t width, uint16_t height, uint8_t speed){
	uint8_t up, down;
	for(up = 0; up < 15; up += speed){
		Draw_Sprite(x, y + up, sprite, width, height);
		for(int i = 72724*3/2; i > 0; i--);
		unDraw_Sprite(x, y + up, width, height);
	}
	for(down = 0; down < 15; down += speed){ 
		Draw_Sprite(x, y + up - down, sprite, width, height);
		for(int i = 72724*3/2; i > 0; i--);
		unDraw_Sprite(x, y + up - down, width, height);
	}
}

/**
* function makes Pikachu jump then run off the screen.
*/
void mainScreenAnimation(void){
	uint16_t x = 53, y = 0, width = 23, height = 23;
	uint8_t left;

	//setup graphics interrupt
	Clear_Buffer(0xFFFF);
	Set_Screen(0);
	Start_Refresh();	
	
	//animation
	Pikachu_Cry();
	jump(x, y, Pikachu2, width, height, 1);
	for(left = 0; left < 58 + width; left += 1){
		Draw_Sprite(x - left, y, Pikachu2, width, height);
		for(int i = 72724*2; i > 0; i--);
		unDraw_Sprite(x - left, y, width, height);
	}
	
	Stop_Refresh();
}
/**
* function displays Red tossing his pokeball.
*/
void pkmnTrainerRedAnimation(void){

	//setup graphics interrupt
	Clear_Buffer(0xFFFF);		//set buffer to white
	Set_Screen(0);
	Start_Refresh();
	
	for(int i = 0; i < 10; i++){ 
		Draw_Sprite(45, 0, Red2, 25, 45);
		jump(63, 28, pokeball2, 7, 7, 1);
	}
	for(int i = 72724*3/2; i > 0; i--);
	Stop_Refresh();
}

/**
* function "throws" a move sprite at the opponent.
* param: *sprite - reference to image sprite
* param: width - width of sprite
* param: height - height of sprite
* param: side - which side sent the attack
*/
void attackAnimation(const unsigned short sprite[], uint16_t width, uint16_t height, uint8_t side){
	//format values
	if(side == 0){	//Player1 side
		for(int i = 0; i < 26; i++){
			Draw_Sprite(42 + i, 14 + i/2, sprite, width, height);
			for(int i = 72724*3/2; i > 0; i--);
			unDraw_Sprite(42 + i, 14 + i/2, width, height);
		}
	}else{	//Player2 side
		for(int i = 0; i < 26; i++){
			Draw_Sprite(70 - i, 26 - i/2, sprite, width, height);
			for(int i = 72724*3/2; i > 0; i--);
			unDraw_Sprite(70 - i, 26 - i/2, width, height);
		}
	}
}
